/*
 * Copyright (c) 2020 The ZMK Contributors
 *
 * SPDX-License-Identifier: MIT
 */

#include <behaviors.dtsi>
#include <dt-bindings/zmk/keys.h>
#include <dt-bindings/zmk/bt.h>

// layers
#define DEFAULT 0
#define RAISE   1
#define GAME  2
#define TAIPO   3
#define TEST 4

// CONFIG
#define COMBO_TIMEOUT 30
#define COMBO_LAYERS 3
#define STICKY_TIMEOUT 500

// LEFT SIDE
#define TLI 3 // TOP Index
#define TLM 2 // TOP Middle
#define TLR 1 // TOP Ring
#define TLP 0 // TOP Pinky
#define BLI 13 // BOTTOM
#define BLM 12 // BOTTOM
#define BLR 11 // BOTTOM
#define BLP 10 // BOTTOM
#define LOT 34 // O-THUMB
#define LIT 33 // I-THUMB

// extra defs for 3rd and 4th rows

#define LOIT 4 // Left Outer Index Top
#define LOIB 14 // Left Outer Index Bottom
#define LAP 20 // Left Aux Pinky
#define LAR 21 // Left Aux Ring
#define LAM 22 // Left Aux Middle
#define LAI 23 // Left Aux Index
#define LOIA 24 // Left Outer Index Aux
#define LMP 30 // Left Mod Pinky
#define LMR 31 // Left Mod Ring
#define LMM 32 // Left Mod Middle

// RIGHT SIDE
#define TRI 6 // TOP
#define TRM 7 // TOP
#define TRR 8 // TOP
#define TRP 9 // TOP
#define BRI 16 // BOTTOM
#define BRM 17 // BOTTOM
#define BRR 18 // BOTTOM
#define BRP 19 // BOTTOM
#define ROT 35 // O-THUMB
#define RIT 36 // I-THUMB

// extra defs for 3rd and 4th rows

#define ROIT 5 // Right Outer Index Top
#define ROIB 15 // Right Outer Index Bottom
#define RAP 29 // Right Aux Pinky
#define RAR 28 // Right Aux Ring
#define RAM 27 // Right Aux Middle
#define RAI 26 // Right Aux Index
#define ROIA 25 // Right Outer Index Aux
#define RMP 38 // Right Mod Pinky
#define RMR 37 // Right Mod Ring

// | 0  |  1  |  2  |  3  |  4  |      |  5  |  6  |  7   |  8  |  9  |
// | 10 |  11 |  12 |  13 |  14 |      |  15 |  16 |  17  |  18 |  19 |
// | 20 |  21 |  22 |  23 |  24 |      |  25 |  26 |  27  |  28 |  29 |
// | 30 |  31 |  32 |  33 |  34 |      |  35 |  36 |    37   |   38   |

&sk {
    release-after-ms = <STICKY_TIMEOUT>;
    quick-release;
};

/ {

    behaviors {
        td0: layer_tap_dance {
            compatible = "zmk,behavior-tap-dance";
            label = "LAYER_TAP_DANCE";
            #binding-cells = <0>;
            tapping-term-ms = <200>;
            bindings = <&tog TAIPO>, <&tog GAME>;
        };
    };

    combos {
      compatible = "zmk,combos";
      #include "taipo.dtsi"

      combo_l_esc { \
            timeout-ms = <COMBO_TIMEOUT>; \
            bindings = <&kp ESC>; \
            key-positions = <ROT RAP RAR>; \
            layers = <0>; \
        };

      combo_l_n0 { \
            timeout-ms = <COMBO_TIMEOUT>; \
            bindings = <&kp N0>; \
            key-positions = <ROT BRI BRM>; \
            layers = <0>; \
        };

        combo_l_n1 { \
            timeout-ms = <COMBO_TIMEOUT>; \
            bindings = <&kp N1>; \
            key-positions = <ROT BRI BRR>; \
            layers = <0>; \
        };

        combo_l_n2 { \
            timeout-ms = <COMBO_TIMEOUT>; \
            bindings = <&kp N2>; \
            key-positions = <ROT BRR BRM>; \
            layers = <0>; \
        };

        combo_l_n3 { \
            timeout-ms = <COMBO_TIMEOUT>; \
            bindings = <&kp N3>; \
            key-positions = <ROT BRP BRM>; \
            layers = <0>; \
        };

        combo_l_n4 { \
            timeout-ms = <COMBO_TIMEOUT>; \
            bindings = <&kp N4>; \
            key-positions = <ROT BRP BRR>; \
            layers = <0>; \
        };

        combo_l_n5 { \
            timeout-ms = <COMBO_TIMEOUT>; \
            bindings = <&kp N5>; \
            key-positions = <ROT TRI TRM>; \
            layers = <0>; \
        };

        combo_l_n6 { \
            timeout-ms = <COMBO_TIMEOUT>; \
            bindings = <&kp N6>; \
            key-positions = <ROT TRI TRR>; \
        };

        combo_l_n7 { \
            timeout-ms = <COMBO_TIMEOUT>; \
            bindings = <&kp N7>; \
            key-positions = <ROT TRR TRM>; \
        };

        combo_l_n8 { \
            timeout-ms = <COMBO_TIMEOUT>; \
            bindings = <&kp N8>; \
            key-positions = <ROT TRP TRM>; \
            layers = <0>; \
        };

        combo_l_n9 { \
            timeout-ms = <COMBO_TIMEOUT>; \
            bindings = <&kp N9>; \
            key-positions = <ROT TRP TRR>; \
            layers = <0>; \
        };
    };

    keymap {
        compatible = "zmk,keymap";

        default_layer {
// -----------------------------------------------------------------------------------------
// | Q |  W  |  F  |  P  |  B |      |  J  |  L  |  U   |  Y  |  ;  |
// | A |  R  |  S  |  T  |  G |      |  K  |  N  |  E   |  I  |  O  |
// | Z |  X  |  C  |  D  |  V |      |  M  |  H  |  ,   |  .  |  /  |
// |CMD| CTL | ALT |SHFT |BSPC|      |  HI | SPC |   TAIPO   |   RET   |
                bindings = <
&kp Q   &kp W &kp F &kp P &kp B                   &kp J  &kp L &kp U  &kp Y     &kp SEMI  
&kp A &kp R &kp S &kp T &kp G                     &kp K  &kp N &kp E  &kp I     &kp O  
&kp Z &kp X &kp C &kp D &kp V                     &kp M  &kp H &kp COMMA  &kp DOT &kp SLASH
&kp LCMD &kp LCTL &kp LALT &kp LSHFT &kp BSPC     &mo RAISE  &kp SPACE   &td0  &kp RET
                >;
        };

        raise_layer {
                bindings = <
&bt BT_CLR  &none  &none  &none  &none           &none  &none  &none &none  &none
&none  &none  &none  &none  &none                &none  &none  &none &none  &kp APOS
&bt BT_SEL 0  &bt BT_SEL 1  &bt BT_SEL 2  &bt BT_SEL 3  &none       &none &none  &kp LC(LEFT)  &kp LC(RIGHT)  &none
&none  &none  &none  &none  &none                &none  &none   &td0   &none  
                >;
        };

        game_layer {
                bindings = <
&kp Q   &kp W &kp F &kp P &kp B                   &kp J  &kp L &kp U  &kp Y     &kp SEMI  
&kp A &kp R &kp S &kp T &kp G                     &kp K  &kp N &kp E  &kp I     &kp O  
&kp Z &kp X &kp C &kp D &kp V                     &kp M  &kp H &kp COMMA  &kp DOT &kp SLASH
&kp LBKT &kp LCTL &kp LALT &kp LSHFT &kp BSPC     &mo RAISE  &kp SPACE   &td0  &kp RET
                >;
        };

        taipo_layer {
                bindings = <
&none  &none  &none  &none  &none              &none  &none  &none  &none  &none
&none  &none  &none  &none  &none              &none  &none  &none  &none  &none
&none  &none  &none  &none  &none              &none  &none  &none  &none  &none
&none  &none  &none  &none  &none              &none  &none   &tog TAIPO   &none
                >;
        };

    };
};
