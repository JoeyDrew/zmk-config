## config/boards/shields/split38/Kconfig.defconfig
```kconfig
if SHIELD_SPLIT38_LEFT

config ZMK_KEYBOARD_NAME
    default "split38"

config ZMK_SPLIT_ROLE_CENTRAL
    default y

endif

if SHIELD_SPLIT38_LEFT || SHIELD_SPLIT38_RIGHT

config ZMK_SPLIT
    default y

endif
```

## config/boards/shields/split38/Kconfig.shield
```kconfig
config SHIELD_SPLIT38_LEFT
    def_bool $(shields_list_contains,split38_left)

config SHIELD_SPLIT38_RIGHT
    def_bool $(shields_list_contains,split38_right)
```

## config/boards/shields/split39/Kconfig.defconfig
```kconfig
if SHIELD_SPLIT39_LEFT

config ZMK_KEYBOARD_NAME
    default "split39"

config ZMK_SPLIT_ROLE_CENTRAL
    default y

endif

if SHIELD_SPLIT39_LEFT || SHIELD_SPLIT39_RIGHT

config ZMK_SPLIT
    default y

endif
```

## config/boards/shields/split39/Kconfig.shield
```kconfig
config SHIELD_SPLIT39_LEFT
    def_bool $(shields_list_contains,split39_left)

config SHIELD_SPLIT39_RIGHT
    def_bool $(shields_list_contains,split39_right)
```
